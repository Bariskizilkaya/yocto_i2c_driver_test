## meta-pmu/conf/layer.conf
```bitbake
# We have a conf and classes directory, add to BBPATH
BBPATH .= ":${LAYERDIR}"

# We have recipes-* directories, add to BBFILES
BBFILES += "${LAYERDIR}/recipes-*/*/*.bb \
            ${LAYERDIR}/recipes-*/*/*.bbappend"

BBFILE_COLLECTIONS += "meta-pmu"
BBFILE_PATTERN_meta-pmu = "^${LAYERDIR}/"
BBFILE_PRIORITY_meta-pmu = "6"

LAYERDEPENDS_meta-pmu = "core"
LAYERSERIES_COMPAT_meta-pmu = "kirkstone"
```
